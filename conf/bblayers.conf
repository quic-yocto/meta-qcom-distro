## conf/bblayers.conf
```bitbake
# LAYER_CONF_VERSION is increased each time build/conf/bblayers.conf
# changes incompatibly
LCONF_VERSION = "7"
WORKSPACE := "${@os.path.abspath(os.path.dirname(d.getVar('FILE', True)))}/../.."

BBPATH = "${TOPDIR}"

BBFILES = " \
"

# These layers hold recipe metadata not found in OE-core, but lack any machine or distro content
BASELAYERS ?= " \
  ${WORKSPACE}/layers/meta-openembedded/meta-oe \
  ${WORKSPACE}/layers/meta-openembedded/meta-filesystems \
  ${WORKSPACE}/layers/meta-openembedded/meta-networking \
  ${WORKSPACE}/layers/meta-openembedded/meta-perl \
  ${WORKSPACE}/layers/meta-openembedded/meta-python \
  ${WORKSPACE}/layers/meta-openembedded/meta-gnome \
  ${WORKSPACE}/layers/poky/meta \
  ${WORKSPACE}/layers/poky/meta-poky \
  ${WORKSPACE}/layers/meta-security \
  ${WORKSPACE}/layers/meta-selinux \
  ${WORKSPACE}/layers/meta-virtualization \
"

# These layers hold machine specific content, aka Board Support Packages
BSPLAYERS ?= " \
  ${WORKSPACE}/layers/meta-qcom-hwe \
  ${WORKSPACE}/layers/meta-qcom \
"

# Add your overlay location to EXTRALAYERS
# Make sure to have a conf/layers.conf in there
EXTRALAYERS ?= ""

BBLAYERS = " \
  ${WORKSPACE}/layers/meta-qcom-distro \
  ${EXTRALAYERS} \
  ${BASELAYERS} \
  ${BSPLAYERS} \
"
```

## conf/distro/include/qcom-base.inc
```bitbake
DISTRO_VERSION ??= "1.0"

# Supported selections are: base, custom
# We intend to use same selection as that of BSP by default.
# Specific DISTROs might change this as needed.
DISTROOVERRIDES =. "qcom-${QCOM_SELECTED_BSP}-distro:"

# SDK variables.
SDK_VERSION = "${DISTRO_VERSION}"
SDK_NAME = "${DISTRO}-${SDKMACHINE}-${IMAGE_BASENAME}-${TUNE_PKGARCH}-${MACHINE}"
SDK_VENDOR = "-qcomsdk"

TARGET_VENDOR = "-qcom"

# defaultsetup.inc gets includes after ${DISTRO}.conf, so we need to set it here
# to make the python below work. Local, site and auto.conf will override it.
TCMODE ?= "default"

DISTRO_FEATURES:append = " pam overlayfs acl xattr selinux ptest security virtualization tpm usrmerge"

# Use systemd init manager for system initialization.
INIT_MANAGER = "systemd"
VIRTUAL-RUNTIME_init_manager = "systemd"
VIRTUAL-RUNTIME_dev_manager  = "udev"

PACKAGECONFIG:append:pn-systemd = " resolved networkd"

# Use rsyslog as default syslog utility
VIRTUAL-RUNTIME_base-utils-syslog = "rsyslog"

# Avoid to duplicate the rootfs tarball by generating both tar.gz/tar.xz
IMAGE_FSTYPES:remove = "tar.gz"

# Pull in the initrd image by default
INITRAMFS_IMAGE_BUNDLE ?= "1"
INITRAMFS_IMAGE = "${@bb.utils.contains('DISTRO_FEATURES', 'sota', 'initramfs-ostree-image', 'initramfs-qcom-image', d)}"

INHERIT += "buildhistory"
INHERIT += "image-buildinfo"
INHERIT += "recipe_sanity"

## Performance build customizations.
# In PERFORMANCE_BUILD let /var/log be volatile (i.e. not on persistent storage)
# by symlinking /var/log to /var/volatile/log
VOLATILE_LOG_DIR = "${@bb.utils.contains('PERFORMANCE_BUILD', '1', 'yes', 'no', d)}"

# Drop console from Kernel cmdline.
CONSOLE_CMDLINE = "${@oe.utils.conditional('PERFORMANCE_BUILD','1','console=','console=ttyMSM0,115200n8 earlycon',d)}"
# Disable serial console
SERIAL_CONSOLES = "${@oe.utils.conditional('PERFORMANCE_BUILD','1','','115200;ttyMSM0',d)}"

BUILDHISTORY_COMMIT = "1"

# docker-ce has been deprecated, so switch to docker-moby as the preferred provider.
PREFERRED_PROVIDER_virtual/docker = "docker-moby"

# Enable uninative for reuse -native sstate across hosts.
require conf/distro/include/yocto-uninative.inc
INHERIT += "uninative"

# GCC Version
GCCVERSION = "11.5%"

# Easily switch between rust versions just by changing RUST_VERSION variable
RUST_VERSION ?= "1.73.0"

PREFERRED_VERSION_cargo ?= "${RUST_VERSION}"
PREFERRED_VERSION_cargo-native ?= "${RUST_VERSION}"
PREFERRED_VERSION_libstd-rs ?= "${RUST_VERSION}"
PREFERRED_VERSION_rust ?= "${RUST_VERSION}"
PREFERRED_VERSION_rust-cross-${TARGET_ARCH} ?= "${RUST_VERSION}"
PREFERRED_VERSION_rust-llvm ?= "${RUST_VERSION}"
PREFERRED_VERSION_rust-llvm-native ?= "${RUST_VERSION}"
PREFERRED_VERSION_rust-native ?= "${RUST_VERSION}"

# Selinux support
DISTRO_FEATURES_FILTER_NATIVE:append = " selinux"
DISTRO_FEATURES_FILTER_NATIVESDK:append = " selinux"
DISTRO_EXTRA_RDEPENDS:append = " ${@bb.utils.contains('DISTRO_FEATURES','selinux', 'packagegroup-selinux-minimal', '', d)}"
PREFERRED_PROVIDER_virtual/refpolicy = "refpolicy-mls"

# Disable selinux in default
DEFAULT_ENFORCING ?= "disabled"

SELINUX_FILE_CONTEXTS_EXT4 = " -f ${IMAGE_ROOTFS}/etc/selinux/mls/contexts/files/file_contexts"
EXTRA_IMAGECMD:ext4 += " ${@bb.utils.contains('DISTRO_FEATURES','selinux', '${SELINUX_FILE_CONTEXTS_EXT4}', '', d)}"

# Enable security compiler and linker flags.
require qcom-security_flags.inc

# Ostree variables
OSTREE_BOOTLOADER ?= "none"
OSTREE_SPLIT_BOOT = "1"
OSTREE_LOADER_LINK = "0"
BUILD_OTA_TARBALL = "1"
OSTREE_KERNEL = "${EFI_LINUX_IMG}"
OSTREE_KERNEL_ARGS_COMMON ?= "root=LABEL=otaroot rootfstype=ext4"
OSTREE_KERNEL_ARGS ?= "console=ttyMSM0,115200n8 earlycon pcie_pme=nomsi kernel.sched_pelt_multiplier=4 rcupdate.rcu_expedited=1 rcu_nocbs=0-7 kpti=off kasan=off kasan.stacktrace=off no-steal-acc page_owner=on swiotlb=128 ${OSTREE_KERNEL_ARGS_COMMON}"
SOTA_CLIENT_PROV ?= ""
OSTREE_DEPLOY_DEVICETREE = "0"
OSTREE_DEVICETREE = "${KERNEL_DEVICETREE}"
OSTREE_MULTI_DEVICETREE_SUPPORT = "0"

# Set OPKGLIBDIR to /etc to support OSTree for OTA
OPKGLIBDIR ?= "${@bb.utils.contains('DISTRO_FEATURES', 'sota', '/etc', '/var/lib', d)}"
```

## conf/distro/include/qcom-security_flags.inc
```bitbake
# Pull in the default security flags
require conf/distro/include/security_flags.inc
```

## conf/distro/qcom-wayland.conf
```bitbake
require conf/distro/include/qcom-base.inc

DISTRO_NAME = "QCOM Reference Distro with Wayland"

DISTRO_FEATURES:append = " wayland vulkan opengl"

DISTRO_FEATURES:remove = "x11"
```

## conf/layer.conf
```bitbake
# We have a conf and classes directory, add to BBPATH
BBPATH .= ":${LAYERDIR}"

# We have a packages directory, add to BBFILES
BBFILES += "${LAYERDIR}/recipes-*/*/*.bb \
            ${LAYERDIR}/recipes-*/*/*.bbappend"

BBFILE_COLLECTIONS        += "qcom-distro"
BBFILE_PATTERN_qcom-distro := "^${LAYERDIR}/"
BBFILE_PRIORITY_qcom-distro = "10"

LAYERDEPENDS_qcom-distro = "qcom"
LAYERSERIES_COMPAT_qcom-distro = "styhead"
```

## conf/local.conf
```bitbake
#
# This file is your local configuration file and is where all local user settings
# are placed. The comments in this file give some guide to the options a new user
# to the system might want to change but pretty much any configuration option can
# be set in this file. More adventurous users can look at local.conf.extended
# which contains other examples of configuration which can be placed in this file
# but new users likely don't need any of them initially.
#
# Lines starting with the '#' character are commented out and in some cases the
# default values are provided as comments to show people example syntax. Enabling
# the option is a question of removing the # character and making any change to the
# variable as required.

# CONF_VERSION is increased each time build/conf/ changes incompatibly
CONF_VERSION = "2"

# Which files do we want to parse:
BBMASK = ""

# What kind of images do we want?
IMAGE_FSTYPES:append = " tar.xz"

# Don't generate the mirror tarball for SCM repos, the snapshot is enough
BB_GENERATE_MIRROR_TARBALLS = "0"

# Disable build time patch resolution. This would lauch a devshell
# and wait for manual intervention. We disable it.
PATCHRESOLVE = "noop"

# Parallelism Options
# These options control how much parallelism BitBake should use.
#

# Capture the count of cpu cores available from the host with a max cap at 20.
CPU_COUNT = "${@oe.utils.cpu_count(at_least=2, at_most=20)}"

# Determines how many tasks bitbake should run in parallel.
BB_NUMBER_THREADS ?= "${CPU_COUNT}"

# Determines how many tasks bitbake should run in parallel during parsing.
BB_NUMBER_PARSE_THREADS ?= "${@oe.utils.cpu_count()}"

# Specifies a maximum CPU pressure threshold for bitbake scheduler to start new tasks.
BB_PRESSURE_MAX_CPU = "900000"

# Specifies a maximum IO pressure threshold for bitbake scheduler to start new tasks.
BB_PRESSURE_MAX_IO = "900000"

# Specifies a maximum Memory pressure threshold for bitbake scheduler to start new tasks.
BB_PRESSURE_MAX_MEMORY = "900000"

# Determines how many processes make should run in parallel when running compile tasks.
PARALLEL_MAKE ?= "-j ${CPU_COUNT} -l ${CPU_COUNT}"
```
